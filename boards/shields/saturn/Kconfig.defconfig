## boards/shields/saturn/Kconfig.shield
```kconfig
config SHIELD_SATURN_LEFT
    def_bool $(shields_list_contains,saturn_left)

config SHIELD_SATURN_RIGHT
    def_bool $(shields_list_contains,saturn_right)
```
